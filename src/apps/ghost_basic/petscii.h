// A hand-drawn 8x8 uppercase font in the spirit of the C64 character ROM,
// indexed by *screen code* (not PETSCII). This is an original bitmap, not a
// copy of the copyrighted CHARGEN ROM.
//
// Each glyph is 8 rows top-to-bottom; bit 7 is the leftmost pixel. The set
// covers all 128 screen codes: @, A..Z, brackets/arrows, the punctuation and
// digits block (32..63 line up 1:1 with ASCII), and the graphics set (64..127).
//
// Screen codes carry a reverse-video flag in bit 7 (128..255) exactly like the
// original, so the low 7 bits index this table.
#pragma once

#include <cstdint>

namespace apps::ghost::petscii {

inline constexpr int CW = 8;   // glyph cell width  (pixels)
inline constexpr int CH = 8;   // glyph cell height (pixels)

inline constexpr uint8_t FONT[128][8] = {
    {0x78,0xCC,0xDC,0xDC,0xDC,0xC0,0x78,0x00}, // 0  @
    {0x30,0x78,0xCC,0xCC,0xFC,0xCC,0xCC,0x00}, // 1  A
    {0xF8,0xCC,0xCC,0xF8,0xCC,0xCC,0xF8,0x00}, // 2  B
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    {0x78,0xCC,0x0C,0x18,0x30,0x00,0x30,0x00}, // 63 ?

    // Screen codes 64..127: the PETSCII graphics set. 65..90 are Shift+A..Z
    // (spade, rounded corners, circles, ...), 96..127 the Commodore-key block
    // and box-drawing shapes. Box pieces put the vertical on column 3 and the
    // horizontal on row 3 so corners and tees line up into real frames.
    {0x00,0x00,0x00,0xFF,0x00,0x00,0x00,0x00}, // 64  horizontal line (middle)
    {0x18,0x3C,0x7E,0xFF,0xFF,0x18,0x3C,0x00}, // 65  spade
    {0x08,0x08,0x08,0x08,0x08,0x08,0x08,0x08}, // 66  vertical line, col 4
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    {0xF0,0xF0,0xF0,0xF0,0x0F,0x0F,0x0F,0x0F}, // 127 quadrants upper-left + lower-right
};

// Map a PETSCII/ASCII code to a screen code (0..63). Lowercase folds to
// uppercase, matching the C64's default uppercase/graphics character set.
// Anything unprintable becomes a space.
constexpr uint8_t toScreenCode(uint8_t c) {
    if (c >= 32 && c <= 63)      return c;                 // space..? and digits
    if (c >= 64 && c <= 95)      return uint8_t(c - 64);   // @, A..Z, brackets
    if (c >= 'a' && c <= 'z')    return uint8_t(c - 96);   // see note below
    // The graphics half, reachable with CHR$(160..255).
    if (c >= 160 && c <= 191)    return uint8_t(c - 64);   // -> 96..127
    if (c >= 192 && c <= 223)    return uint8_t(c - 128);  // -> 64..95
    if (c >= 224 && c <= 254)    return uint8_t(c - 128);  // -> 96..126
    if (c == 255)                return 94;                // pi
    return 32;                                             // space
}
// Deviation from the original, on purpose: a real C64 reads 97..122 as the
// Shift+A..Z graphics, because its keyboard speaks PETSCII. Ours speaks ASCII,
// where those codes are lowercase letters — folding them to A..Z is what a
// typist expects. The graphics are all still reachable through CHR$(160..255).

} // namespace apps::ghost::petscii
